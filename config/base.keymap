#include <behaviors.dtsi>
#include <behaviors/num_word.dtsi> // Requires zmk-auto-layer module.
#include <behaviors/unicode.dtsi> // Requires zmk-unicode module.
#include <zmk-helpers/helper.h> // Requires zmk-helpers module.
#include <dt-bindings/zmk/keys.h>
#include <dt-bindings/zmk/rgb.h>
#ifdef CONFIG_WIRELESS
  #include <dt-bindings/zmk/bt.h>
  #include <dt-bindings/zmk/outputs.h>
  #define _BT_SEL_KEYS_                                                        \
      &bt BT_SEL 0 &bt BT_SEL 1 &bt BT_SEL 2 &bt BT_SEL 3 &bt BT_CLR
#else
  #define _BT_SEL_KEYS_ &trans &trans &trans &trans &trans
#endif

#include "zmk-helpers/helper.h"
#include "zmk-helpers/unicode-chars/portuguese.dtsi"
#include "zmk-helpers/unicode-chars/currency.dtsi"

#define DEF 0
#define HDP 1
#define NAV 2
#define FN 3
#define NUM 4
#define SYS 5
#define MOUSE 6
#define SELECT_CONT_SL 7
#define SELECT_CONT 8
#define WORKSPACE 9
#define TMUX 10

#define XXX &none
#define ___ &trans

/* Global defaults */

#define QUICK_TAP_MS 175
#define SELECT_TIMEOUT_MS 60000 // 60 seconds for selection continuity.

&sk {
  release-after-ms = <900>;
  quick-release;
};

&sl { // Allow sticky mods to chord across sticky layers.
  ignore-modifiers;
};

&lt {
  flavor = "balanced";
  tapping-term-ms = <200>;
  quick-tap-ms = <QUICK_TAP_MS>;
};

/* Homerow mods */

#define KEYS_L LT0 LT1 LT2 LT3 LT4 LM0 LM1 LM2 LM3 LM4 LB0 LB1 LB2 LB3 LB4
#define KEYS_R RT0 RT1 RT2 RT3 RT4 RM0 RM1 RM2 RM3 RM4 RB0 RB1 RB2 RB3 RB4
#ifndef LH2
  #define THUMBS LH1 LH0 RH0 RH1         // Thumbs on 34 keys.
#else
  #define THUMBS LH2 LH1 LH0 RH0 RH1 RH2 // Thumbs on 36+ keys.
#endif

#define MAKE_HRM(NAME, HOLD, TAP, TRIGGER_POS)                                 \
  ZMK_HOLD_TAP(NAME, bindings = <HOLD>, <TAP>; flavor = "balanced";            \
               tapping-term-ms = <280>; quick-tap-ms = <QUICK_TAP_MS>;         \
               require-prior-idle-ms = <150>; hold-trigger-on-release;         \
               hold-trigger-key-positions = <TRIGGER_POS>;)

MAKE_HRM(hml, &kp, &kp, KEYS_R THUMBS) // Left-hand HRMs.
MAKE_HRM(hmr, &kp, &kp, KEYS_L THUMBS) // Right-hand HRMs.

// Hack: Make HRM combos tap-only (cf, ZMK issue #544).
#define ZMK_COMBO_8(NAME, TAP, POS, LAYERS, COMBO_MS, IDLE_MS, HOLD, SIDE)     \
  MAKE_HRM(hm_combo_##NAME, &kp, TAP, SIDE THUMBS)                             \
  ZMK_COMBO_6(NAME, &hm_combo_##NAME HOLD 0, POS, LAYERS, COMBO_MS, IDLE_MS)

/* Combos, leader key sequences, mouse emulation */

#include "combos.dtsi" // Must be sourced after HRM-combo hack.
#include "leader.dtsi"
#include "mouse.dtsi"

/* Nav cluster */

// Trigger tap-action on all interrupts.
#define MT_CORE                                                                \
  flavor = "tap-preferred";                                                    \
  tapping-term-ms = <220>;                                                     \
  quick-tap-ms = <220>;                                                        \
  hold-trigger-key-positions = <0>;

&mt { MT_CORE };

ZMK_HOLD_TAP(mt_home, bindings = <&masked_home>, <&kp>; MT_CORE)
ZMK_HOLD_TAP(mt_end, bindings = <&masked_end>, <&kp>; MT_CORE)

#define NAV_LEFT  &mt_home 0   LEFT  // Tap: left  | Long-tap: start of line.
#define NAV_RIGHT &mt_end 0    RIGHT // Tap: right | Long-tap: end   of line.
#define NAV_UP    &mt LC(HOME) UP    // Tap: up    | Long-tap: start of doc.
#define NAV_DOWN  &mt LC(END)  DOWN  // Tap: down  | Long-tap: end   of doc.
#define NAV_BSPC  &mt LC(BSPC) BSPC  // Tap: bspc  | Long-tap: delete word bwd.
#define NAV_DEL   &mt LC(DEL)  DEL   // Tap: del   | Long-tap: delete word fwd.

// Mask CTRL on left/right hold to avoid accidental jumps to start/end of doc.
#define MASK_MODS(NAME, MODS, BINDING)                                         \
  ZMK_MOD_MORPH(NAME, bindings = <BINDING>, <BINDING>; mods = <MODS>;)

MASK_MODS(masked_home, (MOD_LCTL), &kp HOME)
MASK_MODS(masked_end,  (MOD_LCTL), &kp END)

/* Selection continuity helpers */

// Macro to activate sticky layer.
ZMK_MACRO(layer_select_cont_sl, wait-ms = <0>; tap-ms = <0>;
          bindings = <&sl SELECT_CONT_SL>;)

// Tap a key then activate select_cont sticky layer.
#define LAYER_TAP(NAME, BINDING)                                               \
  ZMK_MACRO(NAME, wait-ms = <0>; tap-ms = <0>;                                 \
            bindings = <BINDING>, <&layer_select_cont_sl>;)

/* Magic-shift & auto-layers */

// Tap: sticky-shift | Shift + tap/ double-tap: caps-word | Hold: shift.
#define MAGIC_SHIFT &magic_shift LSHFT 0
ZMK_HOLD_TAP(magic_shift, bindings = <&kp>, <&magic_shift_tap>;
             flavor = "balanced"; tapping-term-ms = <200>;
             quick-tap-ms = <QUICK_TAP_MS>;)
ZMK_MOD_MORPH(magic_shift_tap, bindings = <&sk LSHFT>, <&caps_word>;
              mods = <(MOD_LSFT)>;)
&caps_word { // Mods deactivate caps-word, requires PR #1451. [TODO: rebase]
  /delete-property/ ignore-modifiers;
};

// Tap: num-word | double-tap: sticky num-layer | Hold: num-layer.
#define SMART_NUM &smart_num NUM 0
ZMK_HOLD_TAP(smart_num, bindings = <&mo>, <&num_dance>; flavor = "balanced";
             tapping-term-ms = <200>; quick-tap-ms = <QUICK_TAP_MS>;)
ZMK_TAP_DANCE(num_dance, bindings = <&num_word NUM>, <&sl NUM>;
              tapping-term-ms = <200>;)

// Smart-mouse, requires tri-state module.
ZMK_TRI_STATE(
    smart_mouse, bindings = <&tog MOUSE>, <&none>, <&tog MOUSE>;
    ignored-key-positions =
        <LT1 LT2 LH0 LH1 RT1 RT2 RT3 RM0 RM1 RM2 RM3 RM4 RB1 RB2 RB3 RH0 RH1>;
    ignored-layers = <MOUSE NAV FN>;)

/* Custom behaviors */

// Alt+Tab swapper, requires tri-state module.
ZMK_TRI_STATE(swapper, bindings = <&kt LALT>, <&kp TAB>, <&kt LALT>;
              ignored-key-positions = <LT2 RT2 RM1 RM2 RM3>;)

// Define mod-morph with a *single* mod trigger for less repetition.
#define SIMPLE_MORPH(NAME, MOD, BINDING1, BINDING2)                            \
  ZMK_MOD_MORPH(NAME, mods = <(MOD_L##MOD | MOD_R##MOD)>;                      \
                bindings = <BINDING1>, <BINDING2>;)

// Tap: comma | Shift + tap: semicolon | Ctrl + shift + tap: <.
SIMPLE_MORPH(comma_morph, SFT, &kp COMMA, &comma_inner_morph)
SIMPLE_MORPH(comma_inner_morph, CTL, &kp SEMICOLON, &kp LESS_THAN)

// Tap: dot | Shift + tap: colon | Ctrl + shift + tap: >.
SIMPLE_MORPH(dot_morph, SFT, &kp DOT, &dot_inner_morph)
SIMPLE_MORPH(dot_inner_morph, CTL, &kp COLON, &kp GREATER_THAN)

// Tap: qmark | Shift + tap: excl.
SIMPLE_MORPH(qexcl, SFT, &kp QMARK, &kp EXCL)

// Tap: left/right parenthesis | Shft + tap: less-than/greater-than.
SIMPLE_MORPH(lpar_lt, SFT, &kp LPAR, &kp LT)
SIMPLE_MORPH(rpar_gt, SFT, &kp RPAR, &kp GT)

// Tap: space | Shift + tap: dot -> space -> sticky shift | Hold: nav layer.
ZMK_HOLD_TAP(lt_spc, bindings = <&mo>, <&spc_morph>; flavor = "balanced";
             tapping-term-ms = <200>; quick-tap-ms = <QUICK_TAP_MS>;)
SIMPLE_MORPH(spc_morph, SFT, &kp SPACE, &dot_spc)
ZMK_MACRO(dot_spc, bindings = <&kp DOT &kp SPACE &sk LSHFT>; wait-ms = <0>;
          tap-ms = <5>;)

// Tap: backspace | Lshft + tap: delete | Rshft + tap: shift-delete.
ZMK_MOD_MORPH(bs_del, bindings = <&kp BSPC>, <&kp DEL>;
              mods = <(MOD_LSFT|MOD_RSFT)>; keep-mods = <MOD_RSFT>;)

// Tap: copy | double-tap: cut.
ZMK_TAP_DANCE(copy_cut, bindings = <&kp LC(INS)>, <&kp LC(X)>;
              tapping-term-ms = <200>;)

// Sticky shift + leader.
ZMK_MACRO(leader_sft, bindings = <&sk LSHFT &leader>;)

/* Selection macros with continuity */

// Start selection macros - position cursor then select, then activate sticky layer.
// Word left: move to word end, then select backwards to word start
ZMK_MACRO(sel_word_left_start, wait-ms = <0>; tap-ms = <5>;
          bindings = <&kp LC(RIGHT) &kp LC(LS(LEFT))>, <&layer_select_cont_sl>;)
// Word right: move to word start, then select forwards to word end
ZMK_MACRO(sel_word_right_start, wait-ms = <0>; tap-ms = <5>;
          bindings = <&kp LC(LEFT) &kp LC(LS(RIGHT))>, <&layer_select_cont_sl>;)
// Line up: move to line end, then select backwards to line start
ZMK_MACRO(sel_line_up_start, wait-ms = <0>; tap-ms = <5>;
          bindings = <&kp END &kp LS(HOME)>, <&layer_select_cont_sl>;)
// Line down: move to line start, then select forwards to line end
ZMK_MACRO(sel_line_down_start, wait-ms = <0>; tap-ms = <5>;
          bindings = <&kp HOME &kp LS(END)>, <&layer_select_cont_sl>;)

// Continue selection macros (reactivate sticky layer).
LAYER_TAP(sel_word_left_cont,   &kp LC(LS(LEFT)))
LAYER_TAP(sel_word_right_cont,  &kp LC(LS(RIGHT)))
// Line up: select up then move to line start (cursor at start of newly selected line)
ZMK_MACRO(sel_line_up_cont, wait-ms = <0>; tap-ms = <5>;
          bindings = <&kp LS(UP) &kp HOME>, <&layer_select_cont_sl>;)
// Line down: select down then move to line end (cursor at end of newly selected line)
ZMK_MACRO(sel_line_down_cont, wait-ms = <0>; tap-ms = <5>;
          bindings = <&kp LS(DOWN) &kp END>, <&layer_select_cont_sl>;)

// Misc aliases. [TODO: clean up]
#define CANCEL    &kp K_CANCEL            // Cancel caps-word & auto-layers.
#define DSK_PREV  &hmr LCTRL LG(LC(LEFT)) // Previous desktop.
#define DSK_NEXT  &hmr LALT LG(LC(RIGHT)) // Next     desktop.
#define PIN_WIN   &kp LG(LC(LS(Q)))       // Pin window across desktops.
#define PIN_APP   &kp LG(LC(LS(A)))       // Pin application across desktops.
#define DSK_MGR   &kp LA(GRAVE)           // Desktop manager.
#define VOL_DOWN  &hmr RSHFT C_VOL_DN

/* Workspace navigation aliases (niri) */

// Window/Column navigation within workspace
#define WS_LEFT   &kp LG(H)               // Focus column left
#define WS_DOWN   &kp LG(J)               // Focus window down
#define WS_UP     &kp LG(K)               // Focus window up
#define WS_RIGHT  &kp LG(L)               // Focus column right

// Workspace navigation (up/down on same monitor)
#define WS_NEXT   &kp LG(U)               // Focus workspace down
#define WS_PREV   &kp LG(I)               // Focus workspace up

// Monitor navigation
#define MON_LEFT  &kp LG(LS(H))           // Focus monitor left
#define MON_DOWN  &kp LG(LS(J))           // Focus monitor down
#define MON_UP    &kp LG(LS(K))           // Focus monitor up
#define MON_RIGHT &kp LG(LS(L))           // Focus monitor right

// Move window within workspace
#define MV_LEFT   &kp LG(LC(H))           // Move column left
#define MV_DOWN   &kp LG(LC(J))           // Move window down
#define MV_UP     &kp LG(LC(K))           // Move window up
#define MV_RIGHT  &kp LG(LC(L))           // Move column right

// Move window to workspace
#define MV_WS_NEXT &kp LG(LC(U))          // Move to workspace down
#define MV_WS_PREV &kp LG(LC(I))          // Move to workspace up

// Move window to monitor
#define MV_MON_L  &kp LG(LS(LC(H)))       // Move to monitor left
#define MV_MON_D  &kp LG(LS(LC(J)))       // Move to monitor down
#define MV_MON_U  &kp LG(LS(LC(K)))       // Move to monitor up
#define MV_MON_R  &kp LG(LS(LC(L)))       // Move to monitor right

// Named workspace shortcuts (Mod+1-9,0)
#define WS_1      &kp LG(N1)              // Slack (eDP-1)
#define WS_2      &kp LG(N2)              // Ayugram (eDP-1)
#define WS_3      &kp LG(N3)              // Notion Calendar (eDP-1)
#define WS_4      &kp LG(N4)              // Google Meet (eDP-1)
#define WS_5      &kp LG(N5)              // Bitwarden (eDP-1)
#define WS_6      &kp LG(N6)              // Ghostty (DP-3)
#define WS_7      &kp LG(N7)              // VSCode (DP-3)
#define WS_8      &kp LG(N8)              // Azure Data Studio (DP-3)
#define WS_9      &kp LG(N9)              // Zen Browser (DP-2)
#define WS_0      &kp LG(N0)              // Free (DP-2)

// Window management
#define WS_CLOSE  &kp LG(Q)               // Close window
#define WS_TOGGLE_FLOAT &kp LG(V)         // Toggle floating
#define WS_MAXIMIZE &kp LG(F)             // Maximize column
#define WS_FULLSCREEN &kp LG(LS(F))       // Fullscreen window
#define WS_CENTER &kp LG(C)               // Center column

/* Tmux navigation aliases */

// Prefix: Ctrl+Space
#define TMUX_PREFIX &kp LC(SPACE)         // Tmux prefix key

// Pane navigation (uses vim-tmux-navigator, so direct Ctrl+h/j/k/l)
#define TMUX_LEFT  &kp LC(H)              // Navigate to left pane
#define TMUX_DOWN  &kp LC(J)              // Navigate to down pane
#define TMUX_UP    &kp LC(K)              // Navigate to up pane
#define TMUX_RIGHT &kp LC(L)              // Navigate to right pane

// Pane splitting (prefix + key)
#define TMUX_SPLIT_H &tmux_split_h        // Split horizontally (prefix + \)
#define TMUX_SPLIT_V &tmux_split_v        // Split vertically (prefix + -)

// Pane resizing (prefix + h/j/k/l)
#define TMUX_RESIZE_LEFT  &tmux_resize_left   // Resize pane left (prefix + h)
#define TMUX_RESIZE_DOWN  &tmux_resize_down   // Resize pane down (prefix + j)
#define TMUX_RESIZE_UP    &tmux_resize_up     // Resize pane up (prefix + k)
#define TMUX_RESIZE_RIGHT &tmux_resize_right  // Resize pane right (prefix + l)

// Pane management
#define TMUX_CLOSE &tmux_close            // Close pane (prefix + x)
#define TMUX_MAXIMIZE &tmux_maximize      // Toggle pane zoom (prefix + m)
#define TMUX_ROTATE &tmux_rotate          // Rotate panes (prefix + o)

// Window management
#define TMUX_NEW_WINDOW &tmux_new_window  // New window (prefix + c)
#define TMUX_NEXT_WIN &tmux_next_window   // Next window (prefix + n)
#define TMUX_PREV_WIN &tmux_prev_window   // Previous window (prefix + p)
#define TMUX_WIN_1 &tmux_window_1         // Go to window 1 (prefix + 1)
#define TMUX_WIN_2 &tmux_window_2         // Go to window 2 (prefix + 2)
#define TMUX_WIN_3 &tmux_window_3         // Go to window 3 (prefix + 3)
#define TMUX_WIN_4 &tmux_window_4         // Go to window 4 (prefix + 4)
#define TMUX_WIN_5 &tmux_window_5         // Go to window 5 (prefix + 5)

// Copy mode
#define TMUX_COPY &tmux_copy              // Enter copy mode (prefix + [)
#define TMUX_PASTE &tmux_paste            // Paste (prefix + P)

// Session management
#define TMUX_DETACH &tmux_detach          // Detach from session (prefix + d)
#define TMUX_RELOAD &tmux_reload          // Reload config (prefix + r)

// Tmux command macros (prefix + key combinations)
ZMK_MACRO(tmux_split_h, wait-ms = <0>; tap-ms = <5>;
          bindings = <&kp LC(SPACE) &kp BSLH>;)
ZMK_MACRO(tmux_split_v, wait-ms = <0>; tap-ms = <5>;
          bindings = <&kp LC(SPACE) &kp MINUS>;)
ZMK_MACRO(tmux_resize_left, wait-ms = <0>; tap-ms = <5>;
          bindings = <&kp LC(SPACE) &kp H>;)
ZMK_MACRO(tmux_resize_down, wait-ms = <0>; tap-ms = <5>;
          bindings = <&kp LC(SPACE) &kp J>;)
ZMK_MACRO(tmux_resize_up, wait-ms = <0>; tap-ms = <5>;
          bindings = <&kp LC(SPACE) &kp K>;)
ZMK_MACRO(tmux_resize_right, wait-ms = <0>; tap-ms = <5>;
          bindings = <&kp LC(SPACE) &kp L>;)
ZMK_MACRO(tmux_close, wait-ms = <0>; tap-ms = <5>;
          bindings = <&kp LC(SPACE) &kp X>;)
ZMK_MACRO(tmux_maximize, wait-ms = <0>; tap-ms = <5>;
          bindings = <&kp LC(SPACE) &kp M>;)
ZMK_MACRO(tmux_rotate, wait-ms = <0>; tap-ms = <5>;
          bindings = <&kp LC(SPACE) &kp O>;)
ZMK_MACRO(tmux_new_window, wait-ms = <0>; tap-ms = <5>;
          bindings = <&kp LC(SPACE) &kp C>;)
ZMK_MACRO(tmux_next_window, wait-ms = <0>; tap-ms = <5>;
          bindings = <&kp LC(SPACE) &kp N>;)
ZMK_MACRO(tmux_prev_window, wait-ms = <0>; tap-ms = <5>;
          bindings = <&kp LC(SPACE) &kp P>;)
ZMK_MACRO(tmux_window_1, wait-ms = <0>; tap-ms = <5>;
          bindings = <&kp LC(SPACE) &kp N1>;)
ZMK_MACRO(tmux_window_2, wait-ms = <0>; tap-ms = <5>;
          bindings = <&kp LC(SPACE) &kp N2>;)
ZMK_MACRO(tmux_window_3, wait-ms = <0>; tap-ms = <5>;
          bindings = <&kp LC(SPACE) &kp N3>;)
ZMK_MACRO(tmux_window_4, wait-ms = <0>; tap-ms = <5>;
          bindings = <&kp LC(SPACE) &kp N4>;)
ZMK_MACRO(tmux_window_5, wait-ms = <0>; tap-ms = <5>;
          bindings = <&kp LC(SPACE) &kp N5>;)
ZMK_MACRO(tmux_copy, wait-ms = <0>; tap-ms = <5>;
          bindings = <&kp LC(SPACE) &kp LBKT>;)
ZMK_MACRO(tmux_paste, wait-ms = <0>; tap-ms = <5>;
          bindings = <&kp LC(SPACE) &kp LS(P)>;)
ZMK_MACRO(tmux_detach, wait-ms = <0>; tap-ms = <5>;
          bindings = <&kp LC(SPACE) &kp D>;)
ZMK_MACRO(tmux_reload, wait-ms = <0>; tap-ms = <5>;
          bindings = <&kp LC(SPACE) &kp R>;)

/* Keymap */

ZMK_CONDITIONAL_LAYER(sys, FN NUM, SYS) // FN + NUM --> SYS.
ZMK_CONDITIONAL_LAYER(select_cont_cond, SELECT_CONT_SL, SELECT_CONT) // SELECT_CONT_SL --> SELECT_CONT.

#ifndef ZMK_BASE_LAYER
  #define ZMK_BASE_LAYER(name, LT, RT, LM, RM, LB, RB, LH, RH)                 \
      ZMK_LAYER(name, LT RT LM RM LB RB LH RH)
#endif

ZMK_BASE_LAYER(Base,
//╭─────────────┬─────────────┬─────────────┬─────────────┬─────────────╮ ╭─────────────┬─────────────┬─────────────┬─────────────┬─────────────╮
    &kp Q         &kp W         &kp E         &kp R         &kp T       ,   &kp Y         &kp U         &kp I         &kp O         &kp P       ,
//├─────────────┼─────────────┼─────────────┼─────────────┼─────────────┤ ├─────────────┼─────────────┼─────────────┼─────────────┼─────────────┤
    &hml LGUI A   &hml LALT S   &hml LSHFT D  &hml LCTRL F  &kp G       ,   &kp H         &hmr LCTRL J  &hmr RSHFT K &hmr LALT L   &hmr LGUI SQT ,
//├─────────────┼─────────────┼─────────────┼─────────────┼─────────────┤ ├─────────────┼─────────────┼─────────────┼─────────────┼─────────────┤
    &kp Z         &kp X         &kp C         &kp V         &kp B       ,   &kp N         &kp M         &comma_morph  &dot_morph    &qexcl      ,
//╰─────────────┼─────────────┴─────────────┼─────────────┼─────────────┤ ├─────────────┼─────────────┼─────────────┴───────────────────────────╯
                                              &lt_spc NAV 0 &lt FN RET  ,   SMART_NUM     MAGIC_SHIFT
//                                          ╰─────────────┴─────────────╯ ╰─────────────┴─────────────╯
)

//add hands down promethium here
ZMK_BASE_LAYER(Hdp,
//╭─────────────┬─────────────┬─────────────┬─────────────┬─────────────╮ ╭─────────────┬─────────────┬─────────────┬─────────────┬─────────────╮
    &kp F         &kp P         &kp D         &kp L         &kp X       ,   &comma_morph   &kp U         &kp O         &kp Y         &kp B      ,
//├─────────────┼─────────────┼─────────────┼─────────────┼─────────────┤ ├─────────────┼─────────────┼─────────────┼─────────────┼─────────────┤
    &hml LGUI S   &hml LALT N   &hml LSHFT T  &hml LCTRL H  &kp K       ,   &kp H         &hmr LCTRL A  &hmr RSHFT E  &hmr LALT I   &hmr LGUI C ,
//├─────────────┼─────────────┼─────────────┼─────────────┼─────────────┤ ├─────────────┼─────────────┼─────────────┼─────────────┼─────────────┤
    &kp V         &kp W         &kp G         &kp M         &kp J       ,   &kp MINUS     &dot_morph    &kp SQT        &dot_morph    &qexcl     ,
//╰─────────────┼─────────────┴─────────────┼─────────────┼─────────────┤ ├─────────────┼─────────────┼─────────────┴───────────────────────────╯
                                              &lt NAV R     &lt FN RET  ,   SMART_NUM     MAGIC_SHIFT
//                                          ╰─────────────┴─────────────╯ ╰─────────────┴─────────────╯
)

ZMK_BASE_LAYER(Navigation,
//╭─────────────┬─────────────┬─────────────┬─────────────┬─────────────╮ ╭─────────────┬─────────────┬─────────────┬─────────────┬─────────────╮
    &kp LA(F4)    ___           &kp LS(TAB)   &swapper      ___         ,   NAV_BSPC      &kp PG_DN     &kp PG_UP     NAV_DEL       ___         ,
//├─────────────┼─────────────┼─────────────┼─────────────┼─────────────┤ ├─────────────┼─────────────┼─────────────┼─────────────┼─────────────┤
    &sk LGUI      &sk LALT      &sk LSHFT     &sk LCTRL     ___         ,   NAV_LEFT      NAV_DOWN      NAV_UP        NAV_RIGHT     &kp RET     ,
//├─────────────┼─────────────┼─────────────┼─────────────┼─────────────┤ ├─────────────┼─────────────┼─────────────┼─────────────┼─────────────┤
    ___           ___           &kp INS       &kp TAB       ___         ,   &sel_word_left_start  &sel_line_up_start  &sel_line_down_start  &sel_word_right_start  ___  ,
//╰─────────────┼─────────────┴─────────────┼─────────────┼─────────────┤ ├─────────────┼─────────────┼─────────────┴───────────────────────────╯
                                              ___           ___         ,   ___           CANCEL
//                                          ╰─────────────┴─────────────╯ ╰─────────────┴─────────────╯
)

ZMK_BASE_LAYER(Function,
//╭─────────────┬─────────────┬─────────────┬─────────────┬─────────────╮ ╭─────────────┬─────────────┬─────────────┬─────────────┬─────────────╮
    &kp F12       &kp F7        &kp F8        &kp F9        ___         ,   ___           &kp C_PREV    &kp C_VOL_UP  &kp C_NEXT    ___         ,
//├─────────────┼─────────────┼─────────────┼─────────────┼─────────────┤ ├─────────────┼─────────────┼─────────────┼─────────────┼─────────────┤
    &hml LGUI F11 &hml LALT F4  &hml LSHFT F5 &hml LCTRL F6 ___         ,   ___           DSK_PREV      VOL_DOWN      DSK_NEXT      ___         ,
//├─────────────┼─────────────┼─────────────┼─────────────┼─────────────┤ ├─────────────┼─────────────┼─────────────┼─────────────┼─────────────┤
    &kp F10       &kp F1        &kp F2        &kp F3        ___         ,   PIN_APP       PIN_WIN       DSK_MGR       ___           ___         ,
//╰─────────────┼─────────────┴─────────────┼─────────────┼─────────────┤ ├─────────────┼─────────────┼─────────────┴───────────────────────────╯
                                              ___           ___         ,   &kp C_MUTE    &kp C_PP
//                                          ╰─────────────┴─────────────╯ ╰─────────────┴─────────────╯
)

ZMK_BASE_LAYER(Numbers,
//╭─────────────┬─────────────┬─────────────┬─────────────┬─────────────╮ ╭─────────────┬─────────────┬─────────────┬─────────────┬─────────────╮
    ___           &kp N7        &kp N8        &kp N9        ___         ,   ___           ___           ___           ___           ___         ,
//├─────────────┼─────────────┼─────────────┼─────────────┼─────────────┤ ├─────────────┼─────────────┼─────────────┼─────────────┼─────────────┤
    &hml LGUI N0  &hml LALT N4  &hml LSHFT N5 &hml LCTRL N6 ___         ,   ___           ___           ___           ___           ___         ,
//├─────────────┼─────────────┼─────────────┼─────────────┼─────────────┤ ├─────────────┼─────────────┼─────────────┼─────────────┼─────────────┤
    ___           &kp N1        &kp N2        &kp N3        ___         ,   ___           ___           ___           ___           ___         ,
//╰─────────────┼─────────────┴─────────────┼─────────────┼─────────────┤ ├─────────────┼─────────────┼─────────────┴───────────────────────────╯
                                              ___           ___         ,   ___           ___
//                                          ╰─────────────┴─────────────╯ ╰─────────────┴─────────────╯
)

ZMK_BASE_LAYER(System,
//╭─────────────┬─────────────┬─────────────┬─────────────┬─────────────╮ ╭─────────────┬─────────────┬─────────────┬─────────────┬─────────────╮
                               _BT_SEL_KEYS_                            ,   &out OUT_USB  ___           ___           ___           ___         ,
//├─────────────┼─────────────┼─────────────┼─────────────┼─────────────┤ ├─────────────┼─────────────┼─────────────┼─────────────┼─────────────┤
    &rgb_ug RGB_BRI           &rgb_ug RGB_SPI           &rgb_ug RGB_HUI           ___           &bootloader ,   &bootloader   ___           &tog DEF      &tog HDP  ___         ,
//├─────────────┼─────────────┼─────────────┼─────────────┼─────────────┤ ├─────────────┼─────────────┼─────────────┼─────────────┼─────────────┤
    &rgb_ug RGB_BRD           &rgb_ug RGB_SPD           &rgb_ug RGB_HUD           &rgb_ug RGB_EFF           &sys_reset  ,   &sys_reset    ___           ___           ___           ___         ,
//╰─────────────┼─────────────┴─────────────┼─────────────┼─────────────┤ ├─────────────┼─────────────┼─────────────┴─────────────┼─────────────┤
                                              ___           ___         ,   ___           ___
//                                          ╰─────────────┴─────────────╯ ╰─────────────┴─────────────╯
)

ZMK_BASE_LAYER(Mouse,
//╭─────────────┬─────────────┬─────────────┬─────────────┬─────────────╮ ╭─────────────┬─────────────┬─────────────┬─────────────┬─────────────╮
    ___           ___           ___           ___           ___         ,   ___           &kp PG_UP     U_MS_U         &kp PG_DN    ___         ,
//├─────────────┼─────────────┼─────────────┼─────────────┼─────────────┤ ├─────────────┼─────────────┼─────────────┼─────────────┼─────────────┤
    ___           ___           ___           ___           ___         ,   U_WH_L        U_MS_L        U_MS_D         U_MS_R       U_WH_R      ,
//├─────────────┼─────────────┼─────────────┼─────────────┼─────────────┤ ├─────────────┼─────────────┼─────────────┼─────────────┼─────────────┤
    ___           ___           ___           ___           ___         ,   ___           &mkp LCLK     &mkp MCLK      &mkp RCLK    ___         ,
//╰─────────────┼─────────────┴─────────────┼─────────────┼─────────────┤ ├─────────────┼─────────────┼─────────────┴───────────────────────────╯
                                              ___           ___         ,   U_WH_U        U_WH_D
//                                          ╰─────────────┴─────────────╯ ╰─────────────┴─────────────╯
)

ZMK_BASE_LAYER(SELECT_CONT_SL,
//╭─────────────┬─────────────┬─────────────┬─────────────┬─────────────╮ ╭─────────────┬─────────────┬─────────────┬─────────────┬─────────────╮
    ___           ___           ___           ___           ___         ,   ___           ___           ___           ___           ___         ,
//├─────────────┼─────────────┼─────────────┼─────────────┼─────────────┤ ├─────────────┼─────────────┼─────────────┼─────────────┼─────────────┤
    ___           ___           ___           ___           ___         ,   ___           ___           ___           ___           ___         ,
//├─────────────┼─────────────┼─────────────┼─────────────┼─────────────┤ ├─────────────┼─────────────┼─────────────┼─────────────┼─────────────┤
    ___           ___           ___           ___           ___         ,   ___           ___           ___           ___           ___         ,
//╰─────────────┼─────────────┴─────────────┼─────────────┼─────────────┤ ├─────────────┼─────────────┼─────────────┴───────────────────────────╯
                                              ___           ___         ,   ___           ___
//                                          ╰─────────────┴─────────────╯ ╰─────────────┴─────────────╯
)

ZMK_BASE_LAYER(SELECT_CONT,
//╭─────────────┬─────────────┬─────────────┬─────────────┬─────────────╮ ╭─────────────┬─────────────┬─────────────┬─────────────┬─────────────╮
    ___           ___           ___           ___           ___         ,   ___           ___           ___           ___           ___         ,
//├─────────────┼─────────────┼─────────────┼─────────────┼─────────────┤ ├─────────────┼─────────────┼─────────────┼─────────────┼─────────────┤
    ___           ___           ___           ___           ___         ,   ___           ___           ___           ___           ___         ,
//├─────────────┼─────────────┼─────────────┼─────────────┼─────────────┤ ├─────────────┼─────────────┼─────────────┼─────────────┼─────────────┤
    ___           ___           ___           ___           ___         ,   &sel_word_left_cont  &sel_line_up_cont  &sel_line_down_cont  &sel_word_right_cont  ___  ,
//╰─────────────┼─────────────┴─────────────┼─────────────┼─────────────┤ ├─────────────┼─────────────┼─────────────┴───────────────────────────╯
                                              ___           ___         ,   ___           ___
//                                          ╰─────────────┴─────────────╯ ╰─────────────┴─────────────╯
)

ZMK_BASE_LAYER(Workspace,
//╭─────────────┬─────────────┬─────────────┬─────────────┬─────────────╮ ╭─────────────┬─────────────┬─────────────┬─────────────┬─────────────╮
    WS_1          WS_2          WS_3          WS_4          WS_5        ,   WS_6          WS_7          WS_8          WS_9          WS_0        ,
//├─────────────┼─────────────┼─────────────┼─────────────┼─────────────┤ ├─────────────┼─────────────┼─────────────┼─────────────┼─────────────┤
    &sk LGUI      &sk LALT      &sk LSHFT     &sk LCTRL     WS_PREV     ,   WS_LEFT       WS_DOWN       WS_UP         WS_RIGHT      WS_NEXT     ,
//├─────────────┼─────────────┼─────────────┼─────────────┼─────────────┤ ├─────────────┼─────────────┼─────────────┼─────────────┼─────────────┤
    WS_CLOSE      WS_TOGGLE_FLOAT WS_CENTER   WS_MAXIMIZE   WS_FULLSCREEN , MON_LEFT      MON_DOWN      MON_UP        MON_RIGHT     ___         ,
//╰─────────────┼─────────────┴─────────────┼─────────────┼─────────────┤ ├─────────────┼─────────────┼─────────────┴───────────────────────────╯
                                              ___           ___         ,   ___           CANCEL
//                                          ╰─────────────┴─────────────╯ ╰─────────────┴─────────────╯
)

ZMK_BASE_LAYER(Tmux,
//╭─────────────┬─────────────┬─────────────┬─────────────┬─────────────╮ ╭─────────────┬─────────────┬─────────────┬─────────────┬─────────────╮
    TMUX_WIN_1    TMUX_WIN_2    TMUX_WIN_3    TMUX_WIN_4    TMUX_WIN_5  ,   TMUX_NEW_WINDOW TMUX_PREV_WIN TMUX_NEXT_WIN TMUX_ROTATE ___         ,
//├─────────────┼─────────────┼─────────────┼─────────────┼─────────────┤ ├─────────────┼─────────────┼─────────────┼─────────────┼─────────────┤
    &sk LGUI      &sk LALT      &sk LSHFT     &sk LCTRL     ___         ,   TMUX_LEFT     TMUX_DOWN     TMUX_UP       TMUX_RIGHT    ___         ,
//├─────────────┼─────────────┼─────────────┼─────────────┼─────────────┤ ├─────────────┼─────────────┼─────────────┼─────────────┼─────────────┤
    TMUX_CLOSE    TMUX_SPLIT_V  TMUX_SPLIT_H  TMUX_MAXIMIZE TMUX_RELOAD ,   TMUX_RESIZE_LEFT TMUX_RESIZE_DOWN TMUX_RESIZE_UP TMUX_RESIZE_RIGHT ___  ,
//╰─────────────┼─────────────┴─────────────┼─────────────┼─────────────┤ ├─────────────┼─────────────┼─────────────┴───────────────────────────╯
                                              TMUX_COPY     TMUX_PASTE  ,   TMUX_DETACH   CANCEL
//                                          ╰─────────────┴─────────────╯ ╰─────────────┴─────────────╯
)

/* vim: set ft=c tw=146: */