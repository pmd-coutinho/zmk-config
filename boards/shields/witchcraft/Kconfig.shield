## boards/shields/witchcraft/Kconfig.shield
```kconfig
# No whitespace after the comma or in the keyboard name!
# config SHIELD_WITCHCRAFT_BEACON
#     def_bool $(shields_list_contains,witchcraft_beacon)
    
config SHIELD_CORNE_LEFT
    def_bool $(shields_list_contains,corne_left)

config SHIELD_CORNE_RIGHT
    def_bool $(shields_list_contains,corne_right)
```

## config/boards/shields/klor/Kconfig.defconfig
```kconfig
if SHIELD_KLOR_LEFT

    config ZMK_KEYBOARD_NAME
        default "KLOR"

    config ZMK_SPLIT_BLE_ROLE_CENTRAL
        default y

endif # LEFT



if SHIELD_KLOR_LEFT || SHIELD_KLOR_RIGHT

    config ZMK_SPLIT
        default y


if ZMK_DISPLAY

    config I2C
        default y

    config SSD1306
        default y

endif # ZMK_DISPLAY

config ZMK_DISPLAY_STATUS_SCREEN_CUSTOM
    select LV_USE_LABEL
    select LV_USE_IMG
    select LV_USE_CANVAS
    select LV_USE_ANIMIMG 
    select LV_USE_ANIMATION
    select LV_USE_LINE 
    select LV_FONT_UNSCII_8
    select ZMK_WPM
    imply ZMK_HID_INDICATORS


if LVGL

    config LV_Z_MEM_POOL_SIZE
    default 8192

config LV_Z_VDB_SIZE
    default 64

config LV_DPI_DEF
    default 148

config LV_Z_BITS_PER_PIXEL
    default 1

choice LV_COLOR_DEPTH
    default LV_COLOR_DEPTH_1
endchoice

endif # LVGL


endif # LEFT RIGHT
```
